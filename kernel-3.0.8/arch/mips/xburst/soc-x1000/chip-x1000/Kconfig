## kernel-3.0.8/arch/mips/xburst/soc-x1000/chip-x1000/Kconfig
```kconfig
choice
	prompt "Board type"
	depends on SOC_X1000
	default PRODUCT_X1000_PHOENIX

config  PRODUCT_X1000_PHOENIX
    bool "product x1000 phoenix"

config  PRODUCT_X1000_CANNA
    bool "product x1000 canna"



config  PRODUCT_X1000_NW5061_MAINBOARD
    bool "product x1000 nw5061 mainboard"

config  PRODUCT_X1000_ASLMOM
    bool "product x1000 aslmom"

config  PRODUCT_X1000_YOUTH
    bool "product x1000 youth"

config  PRODUCT_X1000_HL01
    bool "product x1000 hl01"

config  PRODUCT_X1000_SF_AUD_HM02W01
    bool "product x1000 sf_aud_hm02w01"

config  PRODUCT_X1000_HALLEY2
        bool "product x1000 halley2"

config  PRODUCT_X1000_PANSY
        bool "product x1000 pansy"

config  PRODUCT_X1000_JS1
        bool "product x1000 js1"

config  PRODUCT_X1000_JZ_PWM_TEST_BOARD
        bool "product x1000 jz_pwm_test_board"
endchoice

if PRODUCT_X1000_PHOENIX
config PRODUCT_NAME
string
default "phoenix"
source "arch/mips/xburst/soc-x1000/chip-x1000/phoenix/Kconfig"
endif

if PRODUCT_X1000_CANNA
config PRODUCT_NAME
string
default "canna"
source "arch/mips/xburst/soc-x1000/chip-x1000/canna/Kconfig"
endif

if PRODUCT_X1000_NW5061_MAINBOARD
config PRODUCT_NAME
string
default "nw5061_mainboard"
source "arch/mips/xburst/soc-x1000/chip-x1000/nw5061_mainboard/Kconfig"
endif


if PRODUCT_X1000_ASLMOM
config PRODUCT_NAME
string
default "aslmom"
source "arch/mips/xburst/soc-x1000/chip-x1000/aslmom/Kconfig"
endif

if PRODUCT_X1000_YOUTH
config PRODUCT_NAME
string
default "youth"
source "arch/mips/xburst/soc-x1000/chip-x1000/youth/Kconfig"
endif

if PRODUCT_X1000_HL01
config PRODUCT_NAME
string
default "hl01"
source "arch/mips/xburst/soc-x1000/chip-x1000/hl01/Kconfig"
endif

if PRODUCT_X1000_SF_AUD_HM02W01
config PRODUCT_NAME
string
default "sf_aud_hm02w01"
source "arch/mips/xburst/soc-x1000/chip-x1000/sf_aud_hm02w01/Kconfig"
endif

if PRODUCT_X1000_HALLEY2
config PRODUCT_NAME
string
default "halley2"
source "arch/mips/xburst/soc-x1000/chip-x1000/halley2/Kconfig"
endif

if PRODUCT_X1000_PANSY
config PRODUCT_NAME
string
default "pansy"
source "arch/mips/xburst/soc-x1000/chip-x1000/pansy/Kconfig"
endif

if PRODUCT_X1000_JS1
config PRODUCT_NAME
string
default "js1"
source "arch/mips/xburst/soc-x1000/chip-x1000/js1/Kconfig"
endif

if PRODUCT_X1000_JZ_PWM_TEST_BOARD
config PRODUCT_NAME
string
default "jz_pwm_test_board"
source "arch/mips/xburst/soc-x1000/chip-x1000/jz_pwm_test_board/Kconfig"
endif
```

## kernel-3.0.8/arch/mips/xburst/soc-x1000/chip-x1000/js1/Kconfig
```kconfig
choice
prompt "BOARD version"
depends on PRODUCT_X1000_JS1
default BOARD_X1000_JS1_V10

config BOARD_X1000_JS1_V10
bool "board x1000 js1 v10"
depends on PRODUCT_X1000_JS1

endchoice

config BOARD_NAME
string
default "js1_v10" if BOARD_X1000_JS1_V10
```

## kernel-3.0.8/arch/mips/xburst/soc-x1000/chip-x1000/jz_pwm_test_board/Kconfig
```kconfig
choice
prompt "BOARD version"
depends on PRODUCT_X1000_JZ_PWM_TEST_BOARD
default BOARD_X1000_JZ_PWM_TEST_BOARD_V10

config BOARD_X1000_JZ_PWM_TEST_BOARD_V10
bool "board x1000 jz_pwm_test_board v10"
depends on PRODUCT_X1000_JZ_PWM_TEST_BOARD

endchoice

config BOARD_NAME
string
default "jz_pwm_test_board_v10" if BOARD_X1000_JZ_PWM_TEST_BOARD_V10
```

## kernel-3.0.8/arch/mips/xburst/soc-x1000/chip-x1000/nw5061_mainboard/Kconfig
```kconfig
choice
prompt "BOARD version"
depends on PRODUCT_X1000_NW5061_MAINBOARD
default BOARD_X1000_NW5061_MAINBOARD_V10

config BOARD_X1000_NW5061_MAINBOARD_V10
bool "board x1000 nw5061 mainboard v10"
depends on PRODUCT_X1000_NW5061_MAINBOARD


config BOARD_X1000_NW5027
bool "board x1000 canna v22"
depends on PRODUCT_X1000_NW5061_MAINBOARD

config BOARD_X1000_LB
bool "board x1000 lb"
depends on PRODUCT_X1000_NW5061_MAINBOARD
endchoice

config BOARD_NAME
string
default "nw5061_mainboard_v10" if BOARD_X1000_NW5061_MAINBOARD_V10


config BOARD_NAME
string
default "nw5027" if BOARD_X1000_NW5027


config BOARD_NAME
string
default "lb" if BOARD_X1000_LB
```

## kernel-3.0.8/drivers/net/wireless/bcmdhd_43455_8021as/Kconfig
```kconfig
config BCMDHD_43455_8021AS
	tristate "Broadcom FullMAC(bcm43455) IEEE 802.1as wireless cards support"
	---help---
	  This module adds support for wireless adapters based on
	  Broadcom FullMAC chipset.

config BCMDHD_FW_PATH
	depends on BCMDHD_43455_8021AS
	string "Firmware path"
	default "/system/etc/firmware/fw_bcmdhd.bin"
	---help---
	  Path to the firmware file.

config BCMDHD_NVRAM_PATH
	depends on BCMDHD_43455_8021AS
	string "NVRAM path"
	default "/system/etc/firmware/nvram.txt"
	---help---
	  Path to the calibration file.

config BCMDHD_WEXT
	bool "Enable WEXT support"
	depends on BCMDHD_43455_8021AS && CFG80211 = n
	select WIRELESS_EXT
	select WEXT_PRIV
	help
	  Enables WEXT support

choice
	prompt "Enable Chip Interface"
	depends on BCMDHD_43455_8021AS
	---help---
		Enable Chip Interface.
config BCMDHD_SDIO_43455_8021AS
		bool "SDIO bus interface support"
		depends on BCMDHD_43455_8021AS && MMC
config BCMDHD_PCIE_43455_8021AS
		bool "PCIe bus interface support"
		depends on BCMDHD_43455_8021AS && PCI
endchoice

choice
	depends on BCMDHD_43455_8021AS && BCMDHD_SDIO_43455_8021AS
	prompt "Interrupt type"
	---help---
		Interrupt type
config BCMDHD_OOB_43455_8021AS
	depends on BCMDHD_43455_8021AS && BCMDHD_SDIO_43455_8021AS
	bool "Out-of-Band Interrupt"
	---help---
		Interrupt from WL_HOST_WAKE.
config BCMDHD_SDIO_IRQ_43455_8021AS
	depends on BCMDHD_43455_8021AS && BCMDHD_SDIO_43455_8021AS
	bool "In-Band Interrupt"
	---help---
	  Interrupt from SDIO DAT[1]
endchoice
```
